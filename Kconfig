## Kconfig
```kconfig
mainmenu "Infrared Camera Appliance Configuration"

config WANT_BASE_GENERIC
	def_bool n

config WANT_BASE_RPI
	def_bool n

config WANT_TUNE_X32
	def_bool n

choice
	prompt "Select target MACHINE for image"
	default genericx86-64
	help
	  Select the target MACHINE for the ircam-viewer-image.

	config genericx86-64
		select WANT_BASE_GENERIC
		bool "Generic x86_64"
		help
		  Generic x86_64 machine with grub UEFI boot.

	config genericx86-x32
		select WANT_BASE_GENERIC
		select WANT_TUNE_X32
		bool "Generic x86_64-x32"
		help
		  Generic x86_64-x32-psabi machine with grub UEFI boot.

	config genericx86
		select WANT_BASE_GENERIC
		bool "Generic i686"
		help
		  Generic i686 machine with grub UEFI boot.

	config raspberrypi
		select WANT_BASE_RPI
		bool "Raspberry Pi Original"

	config raspberrypi0
		select WANT_BASE_RPI
		bool "Raspberry Pi Zero"

	config raspberrypi0-wifi
		select WANT_BASE_RPI
		bool "Raspberry Pi Zero W"

	config raspberrypi0-2w-64
		select WANT_BASE_RPI
		bool "Raspberry Pi Zero 2W"

	config raspberrypi2
		select WANT_BASE_RPI
		bool "Raspberry Pi 2"

	config raspberrypi3-64
		select WANT_BASE_RPI
		bool "Raspberry Pi 3"

	config raspberrypi4-64
		select WANT_BASE_RPI
		bool "Raspberry Pi 4"

	config raspberrypi5
		select WANT_BASE_RPI
		bool "Raspberry Pi 5"

	config raspberrypi-armv7
		select WANT_BASE_RPI
		bool "Raspberry Pi 32-bit Generic"
		help
		  Supports all known Raspberry Pi revisions except originals.

	config raspberrypi-armv8
		select WANT_BASE_RPI
		bool "Raspberry Pi 64-bit Generic"
		help
		  Supports Raspberry Pi 3, 4, and 5, plus the new 02W.

endchoice

config KAS_BUILD_SYSTEM
	string
	default "oe"

config KAS_INCLUDE_BASE_GENERIC
	string
	default "kas/generic.yml" if WANT_BASE_GENERIC

config KAS_INCLUDE_BASE_RPI
	string
	default "kas/rpi.yml" if WANT_BASE_RPI

config KAS_INCLUDE_X32_TUNE
	string
	default "kas/include/tune-x32.yml" if WANT_TUNE_X32

config MACHINE
	string
	default "genericx86-64" if genericx86-64
	default "genericx86-64" if genericx86-x32
	default "genericx86" if genericx86
	default "genericarm64" if genericarm64
	default "beaglebone-yocto" if beaglebone-yocto
	default "raspberrypi" if raspberrypi
	default "raspberrypi0" if raspberrypi0
	default "raspberrypi0-wifi" if raspberrypi0-wifi
	default "raspberrypi0-2w-64" if raspberrypi0-2w-64
	default "raspberrypi2" if raspberrypi2
	default "raspberrypi3-64" if raspberrypi3-64
	default "raspberrypi4-64" if raspberrypi4-64
	default "raspberrypi5" if raspberrypi5
	default "raspberrypi-armv7" if raspberrypi-armv7
	default "raspberrypi-armv8" if raspberrypi-armv8
```

## conf/distro/ircam.conf
```bitbake
require conf/distro/include/gcsections.inc

DISTRO_NAME = "ircam"
DISTRO_VERSION = "0.5"
DISTRO_FEATURES = "opengl usbhost"
FULL_OPTIMIZATION = "-Os"
TCLIBC = "glibc"

INIT_MANAGER = "mdev-busybox"
VIRTUAL-RUNTIME_init_manager = "busybox"
VIRTUAL-RUNTIME_login_manager = "busybox"
VIRTUAL-RUNTIME_dev_manager = "busybox-mdev"

USE_NLS = "no"
IMAGE_LINGUAS = " "
ENABLE_WIDEC:class-native = "true"
ENABLE_WIDEC = "false"
```

## conf/layer.conf
```bitbake
BBPATH .= ":${LAYERDIR}"

BBFILES += " \
	${LAYERDIR}/recipes-*/*/*.bb \
	${LAYERDIR}/recipes-*/*/*.bbappend \
	"

BBFILES_DYNAMIC += " \
	yocto-bsp:${LAYERDIR}/dynamic-layers/yocto-bsp/*/*/*.bbappend \
	"

BBFILE_COLLECTIONS += "ircam-viewer-layer"
BBFILE_PATTERN_ircam-viewer-layer = "^${LAYERDIR}/"
BBFILE_PRIORITY_ircam-viewer-layer = "9"

LAYERDEPENDS_ircam-viewer-layer = "core"
LAYERSERIES_COMPAT_ircam-viewer-layer = "walnascar whinlatter wrynose"
```
